      DATA GFORCEBW(-1,1)/0/
      DATA GFORCEBW(-2,1)/0/
      DATA GFORCEBW(-1,2)/0/
      DATA GFORCEBW(-2,2)/0/
      DATA GFORCEBW(-1,3)/0/
      DATA GFORCEBW(-2,3)/0/
      DATA GFORCEBW(-1,4)/0/
      DATA GFORCEBW(-2,4)/0/
      DATA GFORCEBW(-1,5)/0/
      DATA GFORCEBW(-2,5)/0/
      DATA GFORCEBW(-1,6)/0/
      DATA GFORCEBW(-2,6)/0/
      DATA GFORCEBW(-1,10)/0/
      DATA GFORCEBW(-1,11)/0/
      DATA GFORCEBW(-1,12)/0/
      DATA GFORCEBW(-1,16)/0/
      DATA GFORCEBW(-1,17)/0/
      DATA GFORCEBW(-1,18)/0/
      DATA GFORCEBW(-1,19)/0/
      DATA GFORCEBW(-1,20)/0/
      DATA GFORCEBW(-1,21)/0/
      DATA GFORCEBW(-1,22)/0/
      DATA GFORCEBW(-1,23)/0/
      DATA GFORCEBW(-1,24)/0/
